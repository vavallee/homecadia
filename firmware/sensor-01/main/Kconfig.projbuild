## firmware/sensor-01/main/Kconfig.projbuild
```kconfig
menu "homecadia sensor-01"

config HOMECADIA_BENCH_SELFTEST
    bool "Bench harness self-test at boot"
    default n
    help
        Before any driver initialises, probe every pin in app_config.h and log
        its electrical state: drive-test the outputs (ePaper command lines, LED)
        and read the line state of the inputs (BUSY, I2C, encoder, battery ADC).
        Also enables verbose UI/display event logging.

        One reset after any wiring change tells you whether the harness is
        right. Bench profile only (sdkconfig.bench): it adds boot time and log
        noise and has no place in a shipping image.

config HOMECADIA_BENCH_PIN_HOLD
    bool "Hold MOSI/SCK/D9/D7 at boot for multimeter readings"
    depends on HOMECADIA_BENCH_SELFTEST
    default n
    help
        Adds 150s to boot: parks the four adjacent driver-board breakout pins
        (EPD MOSI, EPD SCK, ENC A, LED) with internal pull-ups on, driving one
        neighbour low per phase, so a multimeter can read each pin to GND.

        The pull-up forms a calibrated divider: 3.3 * R / (45k + R). That sizes
        a leak that only conducts under power, which an unpowered ohmmeter
        cannot detect. Turn this off once the path is identified.

config HOMECADIA_SLEEP_DIAG
    bool "Light-sleep counters on the DIAG screen (diagnostic image)"
    depends on FREERTOS_USE_TICKLESS_IDLE
    select PM_LIGHT_SLEEP_CALLBACKS
    select ESP_SLEEP_DEBUG
    default n
    help
        Counts every automatic light-sleep request, whether IDF attempted it,
        how long the chip slept, what woke it and which power domains it
        powered down, and redraws those on the DIAG view every 60 s in place
        of its normal content (the dial cannot open the view on battery).

        Read from the glass, never over USB: a USB host keeps the chip out of
        light sleep (CONFIG_USJ_NO_AUTO_LS_ON_CONNECTION), which hides the
        thing being measured. Added 2026-09-15 to find the ~300 uA sleep
        load (docs/field-notes.md section 21). Not for shipping images.

choice HOMECADIA_SLEEP_DIAG_POLL_BISECT
    prompt "Hang bisect: what the sensor poll skips"
    depends on HOMECADIA_SLEEP_DIAG
    default HOMECADIA_SLEEP_DIAG_POLL_FULL
    help
        For the hang that stops the sensor at the 4th 120 s poll, ~480 s after
        boot, whenever CONFIG_PM_POWER_DOWN_PERIPHERAL_IN_LIGHT_SLEEP is on
        (docs/field-notes.md sections 20 and 21). The DIAG redraw keeps
        running in every variant, so the screen still shows whether the chip
        is alive. Skipped reads are replaced by fixed values so the rest of
        the poll (delta check, report, refresh) behaves normally.

config HOMECADIA_SLEEP_DIAG_POLL_FULL
    bool "nothing: the normal poll"

config HOMECADIA_SLEEP_DIAG_NO_POLL
    bool "the whole poll (poll_cb returns at once)"

config HOMECADIA_SLEEP_DIAG_POLL_NO_SHT40
    bool "only the SHT40 I2C read (fixed 21.0 C / 50 %RH)"

config HOMECADIA_SLEEP_DIAG_POLL_NO_ADC
    bool "only the battery ADC read (fixed 3700 mV)"

endchoice

config HOMECADIA_UNPAIRED_DEEP_SLEEP
    bool "An unpaired unit deep-sleeps when its commissioning window closes"
    default y if PM_ENABLE
    default n
    help
        An unpaired unit draws ~28 mA and never light-sleeps. With this on, it
        enters deep sleep once the commissioning window has closed with no
        fabric, and a turn of the dial (encoder A, an LP GPIO) reboots it into
        a new window. Off in the bench profile, whose console needs USB.

config HOMECADIA_UNPAIRED_SLEEP_TEST_S
    int "TEST ONLY: unpaired unit sleeps this many seconds after boot (0 = off)"
    depends on HOMECADIA_UNPAIRED_DEEP_SLEEP
    default 0
    help
        Bench aid for the deep-sleep path: skips the 15-minute window and
        the fail-safe check, and adds a 3 s pause at boot so a USB console
        that re-enumerates after the wake sees the log. Must be 0 in any
        image that ships.

config HOMECADIA_DIAG_DIAL_WAKE_DELAY_S
    int "TEST ONLY: arm the dial's light-sleep wake this many seconds after boot (0 = at boot)"
    depends on PM_ENABLE
    default 0
    help
        A/B for the sleep floor. Arming the dial as a GPIO wake source keeps
        the RTC_PERIPH power domain on through light sleep (ESP-IDF
        sleep_modes.c, RTC_GPIO_TRIG_EN); before the dial could wake the chip,
        the domain went down. With a delay, the first N seconds after boot
        sleep without the wake source, so one PPK2 capture compares the floor
        both ways on the same board. The dial does not wake the chip during
        that window. Must be 0 in any image that ships.

endmenu
```
